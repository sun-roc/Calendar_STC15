#ifndef _SENSOR_H
#define _SENSOR_H
/*************************************************************************/
#define uchar unsigned char
#define uint unsigned int
/***************************DS18B20管脚配置*******************************/
sbit dq = P3 ^ 4;
/********************************************************************************************
* 函数名称：Sensor_Delay(uint16 count)//延时函数
* 功    能：DS18B20软件延时专用
* 入口参数：count    延时参数，值越大，延时越长
* 出口参数：无
*********************************************************************************************/
void Sensor_Delay(uchar count) //延时函数
{
   while (count--)
      ;
}
/********************************************************************************************
* 函数名称：Sensor_Read_Byte()
* 功    能：从DS18B20读一个字节
* 入口参数：无
* 出口参数：从DS18B20读出的一个字节
*********************************************************************************************/
uchar Sensor_Read_Byte(void)
{
   uchar i = 0;
   uchar temp = 0;
   for (i = 8; i > 0; i--)
   {
      dq = 0; // 给脉冲信号
      temp >>= 1;
      dq = 1; // 给脉冲信号
      if (dq)
         temp |= 0x80;
      Sensor_Delay(20);
   }
   return (temp);
}
/********************************************************************************************
* 函数名称：Sensor_Write_Byte()
* 功    能：向DS18B20写一个字节
* 入口参数：temp  要写入DS18B20的一字节数据
* 出口参数：无
*********************************************************************************************/
void Sensor_Write_Byte(uchar temp)
{
   uchar i = 0;
   for (i = 8; i > 0; i--)
   {
      dq = 0;
      dq = temp & 0x01;
      Sensor_Delay(20);
      dq = 1;
      temp >>= 1;
   }
}
/********************************************************************************************
* 函数名称：DS18B20_Init()
* 功    能：DS18B20初始化
* 入口参数：无
* 出口参数：返回值为1则初始化成功
*           返回值为0则初始化失败
*********************************************************************************************/
uchar Sensor_Initial(void)
{
   uchar i = 0;
   dq = 1;            // DQ复位
   Sensor_Delay(1);   // 稍做延时
   dq = 0;            // 单片机将DQ拉低
   Sensor_Delay(100); // 精确延时，大于480us
   dq = 1;            // 拉高总线
   Sensor_Delay(6);   // 稍做延时后
   i = dq;            // 若x=0则初始化成功，若x=1则初始化失败
   Sensor_Delay(130);
   return (~i);
}

/********************************************************************************************
* 函数名称：Sensor_Fresh( temperature  )
* 功    能：读取并显示温度
* 入口参数：无
* 出口参数：无
*********************************************************************************************/
void Sensor_Fresh(uchar *temperature)
{
   Sensor_Initial();
   Sensor_Write_Byte(0xCC); // 跳过读序号列号的操作
   Sensor_Write_Byte(0x44); // 启动温度转换
   Sensor_Initial();
   Sensor_Write_Byte(0xCC);             // 跳过读序号列号的操作
   Sensor_Write_Byte(0xBE);             // 读取温度寄存器
   temperature[0] = Sensor_Read_Byte(); //低位
   temperature[1] = Sensor_Read_Byte(); //高位
} /********************************************************************************/
#endif
